## drivers/sharp/nfc/Kconfig
```kconfig
#
# TOSHIBA NFC Chip driver Support
#

menu "NFC Chip Driver Support"

choice
    prompt "NFC Choice"
    default NFC_8992
config NFC_8992
    bool "TOSHIBA_NFC"
config NFC_8994
    bool "SAMSUNG NFC"
endchoice


config TOSHIBA_NFC
    bool
    default n

config TOSHIBA_NFC_GPIO
    bool "TOSHIBA_NFC GPIO Driver"
    select TOSHIBA_NFC
    depends on NFC_8992
    default n
    ---help---
      Enable the TOSHIBA_NFC GPIO driver for NFC

config TOSHIBA_NFC_I2C
    bool "TOSHIBA_NFC I2C Driver"
    select TOSHIBA_NFC
    default n
    depends on I2C
    depends on NFC_8992
    ---help---
      Enable the TOSHIBA_NFC I2C driver for NFC





config SHNFC3
	bool "NFC device drivers"
	depends on SERIAL_MSM_HSL && I2C
        depends on NFC_8994
	default n
	help
	  Enable NFC(Faver3.0) driver.

config SEC_NFC
    bool "Samsung NFC driver"
	depends on SHNFC3
        depends on NFC_8994
    default n
    help
      SAMSUNG NFC Driver.
      This driver provides support for SAMSUNG NFC products.
      You should select your NFC product and interface.

      Say Y here to compile support for SAMSUNG NFC driver into the
      kernel.

choice
    prompt "SEC NFC Products"
    depends on SEC_NFC
    default SEC_NFC_S3FNRN3_FN
config SEC_NFC_S3FNRN3
    bool "S3FNRN3"
config SEC_NFC_S3FNRN3_FN
    bool "S3FNRN3 for Felica Network"
endchoice

choice
    prompt "SEC NFC Interface"
    depends on SEC_NFC
    default SEC_NFC_UART
config SEC_NFC_UART
    bool "UART"
config SEC_NFC_I2C
    bool "I2C"
endchoice




endmenu
```

## drivers/sharp/shgrip/Kconfig
```kconfig
#
# SHARP Grip Sensor Driver configuration
#

menu "Grip Sensor Driver configuration"

config SENSOR_SHGRIP
	bool "SHARP Grip Sensor Driver"
	default n

config SENSOR_SHGRIP_MODEL1
	bool "SHARP Grip Sensor Model1 Driver"
	depends on SENSOR_SHGRIP
	default n

config SENSOR_SHGRIP_MODEL2_1
	bool "SHARP Grip Sensor Model2-1 Driver"
	depends on SENSOR_SHGRIP
	default n

config SENSOR_SHGRIP_MODEL2_2
	bool "SHARP Grip Sensor Model2-2 Driver"
	depends on SENSOR_SHGRIP
	default n

config SENSOR_SHGRIP_MODEL3
	bool "SHARP Grip Sensor Model3 Driver"
	depends on SENSOR_SHGRIP
	default n
endmenu
```

## drivers/sharp/shlog/Kconfig
```kconfig
# drivers/sharp/shlog/Kconfig

menu "SHLOG_SYSTEM"

comment "SHLOG_SYSTEM"

config SHLOG_SYSTEM
bool "SHLOG_SYSTEM driver"
default y

config SHLOG_SYSTEM_LOGCAT
bool "enable SHLOG_SYSTEM logcat"
depends on SHLOG_SYSTEM
default n


config SHLOG_SYSTEM_PANIC_ON_SUBSYS
bool "enable SHARP handler to call panic when subsystem crashed."
depends on SHLOG_SYSTEM
default n

endmenu
```

## drivers/sharp/shtps/Kconfig
```kconfig
#
# Sharp Touchscreen configuration
#

menu "SHTPS driver"

comment "SHARP Touchscreen device drivers"

config TOUCHSCREEN_SHTPS
	bool "SHARP Touchscreens"
	default n

if TOUCHSCREEN_SHTPS
	config SHTPS_SY3X00_DEV
		config SHTPS_SY3X00_DEV
		tristate "SY3x00 Device"
		default n
		depends on TOUCHSCREEN_SHTPS

	config SHTPS_SY3000_PLG541_001_1
		tristate "SY3000 PLG541-001-1"
		default n
		depends on SHTPS_SY3X00_DEV

	config SHTPS_SY3000_PLG543_001_1
		tristate "SY3000 PLG543-001-1"
		default n
		depends on SHTPS_SY3X00_DEV

	config SHTPS_SY3000_PLG543_001_4
		tristate "SY3000 PLG543-001-4"
		default n
		depends on SHTPS_SY3X00_DEV

	config SHTPS_SY3000_TM3097_001
		tristate "SY3000 TM3097-001"
		default n
		depends on SHTPS_SY3X00_DEV
	
	config SHTPS_SY3000_PLG475_001
                tristate "SY3000 PLG475_001"
                default n
                depends on SHTPS_SY3X00_DEV
	
endif # TOUCHSCREEN_SHTPS

endmenu
```
